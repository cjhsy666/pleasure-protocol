#ifndef GK36_PROTOCOL_H
#define GK36_PROTOCOL_H

#include <Arduino.h>

// ============================================================
// GK36 BLE Protocol Definitions
// Based on reverse-engineered analysis of the original app
// ============================================================

// All packets are 12 bytes, sent via BLE GATT write-without-response
#define PACKET_SIZE 12

// ============================================================
// Shock Channel (0x4B)
// byte6: 0x43=off, 0x47=on
// byte7: intensity (0x23=idle, 0x20-0x27=levels, lower=stronger)
// byte8: mode (cycles: 2B,3B,33,BB)
// ============================================================

enum ShockLevel : uint8_t {
    SHOCK_OFF     = 0,
    SHOCK_IDLE    = 1,  // enabled but no output
    SHOCK_LEVEL_1 = 2,  // lowest
    SHOCK_LEVEL_2 = 3,
    SHOCK_LEVEL_3 = 4,
    SHOCK_LEVEL_4 = 5,
    SHOCK_LEVEL_5 = 6,
    SHOCK_LEVEL_6 = 7,  // highest
};

static const uint8_t SHOCK_PACKETS[8][PACKET_SIZE] = {
    {0x23,0x81,0xBB,0xAB,0xD2,0x4B,0x43,0x23,0xBB,0xA3,0x3B,0x31}, // off
    {0x23,0x81,0xBB,0xAB,0xD2,0x4B,0x47,0x23,0xBB,0xA3,0x3B,0x45}, // idle
    {0x23,0x81,0xBB,0xAB,0xD2,0x4B,0x47,0x20,0x2B,0xA3,0x3B,0x46}, // level 1
    {0x23,0x81,0xBB,0xAB,0xD2,0x4B,0x47,0x21,0x3B,0xA3,0x3B,0x47}, // level 2
    {0x23,0x81,0xBB,0xAB,0xD2,0x4B,0x47,0x22,0x33,0xA3,0x3B,0x44}, // level 3
    {0x23,0x81,0xBB,0xAB,0xD2,0x4B,0x47,0x25,0x3B,0xA3,0x3B,0x3B}, // level 4
    {0x23,0x81,0xBB,0xAB,0xD2,0x4B,0x47,0x26,0x33,0xA3,0x3B,0x48}, // level 5
    {0x23,0x81,0xBB,0xAB,0xD2,0x4B,0x47,0x27,0xBB,0xA3,0x3B,0x49}, // level 6
};

// ============================================================
// Vibration Channel (0xEC)
// byte6 (b6): vibration intensity value
// b6=0x3B is the idle/stop reserved code
// ============================================================

#define VIBRATION_IDLE_B6 0x3B

// Full vibration packet table indexed by b6 value
struct VibrationEntry {
    uint8_t b6;
    uint8_t packet[PACKET_SIZE];
};

static const VibrationEntry VIBRATION_TABLE[] = {
    {0x0D, {0x23,0x81,0xBB,0xAB,0xD2,0xEC,0x0D,0xC3,0xBB,0xA3,0x3B,0xFE}},
    {0x0E, {0x23,0x81,0xBB,0xAB,0xD2,0xEC,0x0E,0xC3,0xBB,0xA3,0x3B,0x01}},
    {0x0F, {0x23,0x81,0xBB,0xAB,0xD2,0xEC,0x0F,0x23,0xBB,0xA3,0x3B,0xFC}},
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    {0x3A, {0x23,0x81,0xBB,0xAB,0xD2,0xEC,0x3A,0xC3,0xBB,0xA3,0x3B,0xA5}},
    // 0x3B = idle/stop, defined separately
    {0x3C, {0x23,0x81,0xBB,0xAB,0xD2,0xEC,0x3C,0x33,0xBB,0xA3,0x3B,0xA3}},
    {0x3D, {0x23,0x81,0xBB,0xAB,0xD2,0xEC,0x3D,0xC3,0xBB,0xA3,0x3B,0xEE}},
    {0x3E, {0x23,0x81,0xBB,0xAB,0xD2,0xEC,0x3E,0xC3,0xBB,0xA3,0x3B,0xF1}},
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    {0x8C, {0x23,0x81,0xBB,0xAB,0xD2,0xEC,0x8C,0x33,0xBB,0xA3,0x3B,0x33}},
};

#define VIBRATION_TABLE_SIZE (sizeof(VIBRATION_TABLE) / sizeof(VIBRATION_ENTRY))

// Idle vibration packet
static const uint8_t VIBRATION_IDLE_PACKET[PACKET_SIZE] = {
    0x23, 0x81, 0xBB, 0xAB, 0xD2, 0xEC, 0x3B, 0x23, 0xBB, 0xA3, 0x3B, 0x90
};

// Slider position 1-100 mapped to b6 values
// Position 1 = weakest, Position 100 = strongest
static const uint8_t VIBRATION_BY_POSITION[100] = {
    0x39, 0x3A, 0x37, 0x38, 0x35, 0x36, 0x33, 0x34, 0x31, 0x32,
    0x2F, 0x30, 0x2D, 0x2E, 0x4B, 0x4C, 0x49, 0x4A, 0x47, 0x48,
    0x45, 0x46, 0x43, 0x44, 0x41, 0x42, 0x3F, 0x40, 0x3D, 0x3E,
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    0x7F, 0x80, 0x7D, 0x7E, 0x5B, 0x5C, 0x59, 0x5A, 0x57, 0x3C,
};

// ============================================================
// Light Channel (0xC8) - two-state toggle
// ============================================================

static const uint8_t LIGHT_STATE_A[PACKET_SIZE] = {
    0x23, 0x81, 0xBB, 0xAB, 0xD2, 0xC8, 0x3B, 0x23, 0xBB, 0xA3, 0x3B, 0xC4
};

static const uint8_t LIGHT_STATE_B[PACKET_SIZE] = {
    0x23, 0x81, 0xBB, 0xAB, 0xD2, 0xC8, 0x3C, 0x33, 0xBB, 0xA3, 0x3B, 0xC7
};

// ============================================================
// Protocol helper functions
// ============================================================

// Look up vibration packet by b6 value
// Returns pointer to packet, or nullptr if not found
inline const uint8_t* vibrationGetPacket(uint8_t b6) {
    if (b6 == VIBRATION_IDLE_B6) {
        return VIBRATION_IDLE_PACKET;
    }
    for (size_t i = 0; i < VIBRATION_TABLE_SIZE; i++) {
        if (VIBRATION_TABLE[i].b6 == b6) {
            return VIBRATION_TABLE[i].packet;
        }
    }
    return nullptr;
}

// Convert slider position (1-100) to b6 value
inline uint8_t vibrationPositionToB6(int position) {
    if (position < 1) position = 1;
    if (position > 100) position = 100;
    return VIBRATION_BY_POSITION[position - 1];
}

// Get shock packet by level (0=off, 1=idle, 2-7=levels)
inline const uint8_t* shockGetPacket(uint8_t level) {
    if (level > 7) level = 7;
    return SHOCK_PACKETS[level];
}

#endif // GK36_PROTOCOL_H
